## Kconfig
```kconfig
config THERMO_TEST_IMPROVED
	bool "Enable the extra tests that kill surviving mutants"
	default n

source "Kconfig.zephyr"
```

## testcase.yaml
```yaml
tests:
  demo.thermo:
    platform_allow:
      - native_sim
      - native_sim/native/64
    tags: mutation
  demo.thermo.improved:
    platform_allow:
      - native_sim
      - native_sim/native/64
    tags: mutation
    extra_configs:
      - CONFIG_THERMO_TEST_IMPROVED=y
```
